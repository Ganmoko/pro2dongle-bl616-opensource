## defconfig
```kconfig
CONFIG_FREERTOS =y
CONFIG_BLUETOOTH =y
CONFIG_BTBLECONTROLLER_LIB =ble1m10s1bredr0
CONFIG_RF =y
CONFIG_BFLB_MTD =y
CONFIG_PARTITION =y
CONFIG_LITTLEFS =y
CONFIG_CHERRYUSB =y
CONFIG_CHERRYUSB_OSAL =freertos
CONFIG_CHERRYUSB_DEVICE =y
CONFIG_CHERRYUSB_DEVICE_HID =y
CONFIG_USBDEV_ADVANCE_DESC =y
CONFIG_EM_SIZE =32
CONFIG_CONSOLE_UART_BAUDRATE =115200
```
